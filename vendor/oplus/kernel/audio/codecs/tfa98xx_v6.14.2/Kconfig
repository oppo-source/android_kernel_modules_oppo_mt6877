## vendor/oplus/kernel/audio/codecs/tfa98xx_v6.14.2/Kconfig
```kconfig
config SND_SOC_TFA98XX
	bool "Support Goodix smartpa driver"
	depends on I2C = y && REGMAP = y
	default y
	help
	  Select this option to enable support for Goodix smartpa driver tfa98xx

config SND_SOC_TFAHAPTIC
	bool "Support Goodix haptic driver"
	depends on I2C = y && REGMAP = y
	default y
	help
	  Select this option to enable support for Goodix haptic driver for TFA9873/4
```

## vendor/oplus/kernel/cpu/freq_tune_policy/Kconfig
```kconfig
# SPDX-License-Identifier: GPL-2.0-only
# Copyright (C) 2025-2035 Oplus. All rights reserved.

config OPLUS_FEATURE_FREQ_TUNE
    tristate "oplus freq tune policy"
    default n
    help
      oplus freq tune policy
```

## vendor/oplus/kernel/cpu/sched/osml_monitor/Kconfig
```kconfig
# SPDX-License-Identifier: GPL-2.0-only

config OPLUS_FEATURE_OSML_MONITOR
  tristate "collect perf_event for system."
  default n
  help
    collect perf_event for system/task.
```

## vendor/oplus/kernel/cpu/smart_freq/Kconfig
```kconfig
# SPDX-License-Identifier: GPL-2.0-only
# Copyright (C) 2025 Oplus. All rights reserved.

config OPLUS_FEATURE_SMART_FREQ
	tristate "add IPC based smart frequency management"
	default n
	help
	  The features adds support for smart freq. management at different IPC
	  levels, whenever any core of a cluster crosses configured IPC level
	  it's associated frequency is set as the IPC smart frequency.
```

## vendor/oplus/kernel/mm/mm_osvelte/Kconfig
```kconfig
config OPLUS_FEATURE_MM_OSVELTE
	tristate "osvelte driver"
	default n
	help
	  This driver used for memory debugging.

config OPLUS_FEATURE_MM_OSVELTE_DBG
	tristate "osvelte driver"
	default n
	help
	  This driver used for memory debugging.

config OPLUS_FEATURE_MM_EZRECLAIMD
	bool "Enable ezreclaimd reclaim pages in background"
	default n
	depends on OPLUS_FEATURE_MM_OSVELTE

config KCOMPRESSD
	bool "Enable kcompressed"
	default n
	depends on OPLUS_FEATURE_MM_OSVELTE

config OPLUS_FEATURE_MGLRU_OPT
	bool "Enable mglru opt"
	default n
	depends on OPLUS_FEATURE_MM_OSVELTE
```

## vendor/oplus/kernel/wifi/oplus_wifi_swtp/Kconfig
```kconfig
# SPDX-License-Identifier: GPL-2.0-only
#
# check gpio of white card
#

config OPLUS_WIFI_SWTP
	tristate "Check Gpio of White Card on MTK Platform"
	help
	  This enables the check gpio status of white card.
	  If unsure, say N.
```
