&soc {
    oplus_mm_config: oplus,mm_config {
        compatible = "oplus,mm_osvelte-config";
        ram-8g {
            oplus_bsp_zram_opt {
                balance_anon_file_reclaim_always_true;
            };
        };
    };
};
