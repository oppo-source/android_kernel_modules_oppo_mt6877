## kernel/kernel_device_modules-6.6/drivers/leds/fan/Kconfig
```kconfig
menuconfig OPLUS_FAN
  tristate "oplus fan support"
  depends on PWM
  help
    this option enables support for the OPLUS FAN.
    Say Y to enable support for the PWM FAN automatically.
    To compile this driver as a module,
    choose M here: the module will be called oplus_fan.

if OPLUS_FAN
config OPLUS_FAN_MTK
	bool "OPLUS fan on MTK"
	help
	  Say Y here to declare fan system is on MTK
endif
```

## kernel/kernel_device_modules-6.6/drivers/misc/mediatek/sensor/2.0/hall/Kconfig
```kconfig
config SENSOR_OPLUS_MHA100KN_HALL
	tristate "for oplus hall"
	default n
	help
	  It support sensor_hall.
```

## kernel/kernel_device_modules-6.6/drivers/ufs/vendor/Kconfig
```kconfig
config UFSFEATURE
	bool "UFS feature activate"
	depends on SCSI_UFSHCD
	help
	  UFS feature activate such as hpb, tw and etc.

config UFSHID
	bool "UFS Host Initiated Defrag support"
	depends on SCSI_UFSHCD && UFSFEATURE
	help
	  UFS HID Feature Enable

config UFSHID_POC
	bool "UFSHID_POC test"
	depends on SCSI_UFSHCD && UFSFEATURE && UFSHID
	help
	  UFS HID POC test
	  1. block to enter suspend state
	  2. auto_hibern8 enable/disable (HCI)
	  3. set flag bDefragOperation
	  4. debug msg enable (default : disable)

config UFS_JEDEC_HID
	bool "UFS Jedec Host Initiated Defrag support"
	depends on SCSI_UFSHCD && UFSFEATURE
	help
	  UFS Jedec HID Feature Enable

config UFS_JEDEC_HID_POC
	bool "UFS_JEDEDCE_HID_POC test"
	depends on SCSI_UFSHCD && UFSFEATURE && UFS_JEDEC_HID
	help
	  UFS Jedec HID POC test
	  1. block to enter suspend state
	  2. auto_hibern8 enable/disable (HCI)
	  3. set flag bDefragOperation
	  4. debug msg enable (default : disable)

config UFSTP
	bool "UFS TurboPocket Support"
	depends on SCSI_UFSHCD && UFSFEATURE
	help
	  Enable UFS TurboPocket

config UFSXLC
	bool "UFS xLC Buffering support"
	depends on SCSI_UFSHCD && UFSFEATURE
	help
	  Enable UFS xLC Buffering

config UFS_MEDIATEK_INTERNAL
	bool "Mediatek UFS Internal Features"
	depends on SCSI_UFSHCD
	help
	  UFS features or code block that is kept available internally
	  and should not be upstreamed.

config UFS_MEDIATEK_MCQ
	bool "Mediatek Proprietary MCQ Support"
	depends on SCSI_UFSHCD && DEVICE_MODULES_SCSI_UFS_MEDIATEK
	help
	  Enable on platform that implemented MediaTek non-standard MCQ.
	  This require Kernel support on mcq vendor hook like in kernel 5.15.

config UFS_MEDIATEK_MT6893
	bool "Mediatek Proprietary platform 6893 Support"
	depends on SCSI_UFSHCD && DEVICE_MODULES_SCSI_UFS_MEDIATEK
	help
	  Enable on MT6893 where implemented UFS related platform changes.
          This is to be in sync with the perf related changes into it

config UFS_MEDIATEK_MT6771
	bool "Mediatek Proprietary platform 6771 Support"
	depends on SCSI_UFSHCD && DEVICE_MODULES_SCSI_UFS_MEDIATEK
	help
	  Enable support for the Mediatek MT6771 platform.
          This configuration ensures compatibility with the atf crypto changes.
          Enabling this option will enable FBE feature for MT6771&MT8788.
          MT6771 need enter atf to program key.
```

## vendor/oplus/sensor/kernel/oplus_virtual_sensor/sensors/chop_detecthub/Kconfig
```kconfig
config OPLUS_FEATURE_CHOP_DETECT
	tristate "chop_detecthub for MediaTek package"
	default n
```

## vendor/oplus/sensor/kernel/oplus_virtual_sensor/sensors/flat_detecthub/Kconfig
```kconfig
config OPLUS_FEATURE_FLAT_DETECT
	tristate "flat_detecthub for MediaTek package"
	default n
```
